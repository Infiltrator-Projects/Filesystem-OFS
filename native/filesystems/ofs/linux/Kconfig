## native/filesystems/ofs/linux/Kconfig
```kconfig
config OFS_FS
	tristate "Amiga OFS filesystem support"
	depends on BLOCK
	select BUFFER_HEAD
	help
	  The canonical OFS engine with a Linux VFS binding. Read/write
	  DOS0, DOS2, DOS4 and DOS6 with 512..32768-byte filesystem blocks,
	  independent of the host page size. FFS is a separate module.
```
